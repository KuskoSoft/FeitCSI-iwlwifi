## drivers/net/wireless/intel/iwlwifi/Kconfig.noupstream
```kconfig
config IWLXVT
	tristate "Enable XVT op_mode"
	depends on IWLWIFI
	select IWLWIFI_DEVICE_TESTMODE
	select IWLWIFI_SUPPORT_DEBUG_OVERRIDES
	help
	  This option enables the xVT operation mode. xVT mode supports
	  special debug and testing operations that are not supported in
	  the standard operation modes, and is used for verification
	  purposes.
	  xVT mode does not support the standard WiFi operations, and
	  does not communicate with the user mode through the nl80211.

	  Enabling this options allows to fully control the HW using
	  an external tool in user space.

	  Say Y if you have the user space application and want
	  to execute debug and testing flows on the HW.

config IWLWIFI_DEVICE_TESTMODE
	bool "enable generic netlink testmode support"
	depends on IWLWIFI
	default y if IWLMVM
	select IWLWIFI_SUPPORT_DEBUG_OVERRIDES

config IWLWIFI_SUPPORT_DEBUG_OVERRIDES
	depends on IWLWIFI
	bool "enable default value override (for debugging)"

config IWLWIFI_FW_MISBEHAVE_NMI_DEFAULT
	depends on IWLWIFI_SUPPORT_DEBUG_OVERRIDES
	int "NMI the firmware on unexpected behaviour"
	range 0 1
	default 1

config IWLWIFI_FORCE_OFDM_RATE
	bool "force transmit to OFDM low rate"
	depends on IWLMVM
	help
	  This option force the FW to transmit OFDM rate.

	  If unsure say N, Say Y if you have this code and want to transmit OFDM low rate.

config IWLMVM_VENDOR_CMDS
	bool "enable vendor commands"
	depends on IWLMVM
	default y
	help
	  This option enables support for vendor commands, including some
	  that don't have their own Kconfig option. Other Kconfig options
	  depend on this one as well.

	  This option mostly exists for non-upstream tagging, so best
	  leave it set to Y.

config IWLWIFI_DISALLOW_OLDER_FW
	bool "disallow fallback to older firmware images"
	depends on IWLWIFI
	help
	  This Kconfig option allows disabling fallback to older firmware images
	  to ensure tight coupling between driver and firmware releases. When
	  enabled, the dbg-cfg framework can still override this setting.

config IWLWIFI_NUM_STA_INTERFACES
	int "number of supported concurrent station interfaces"
	range 1 2
	default 1
	depends on IWLMVM

config REJECT_NONUPSTREAM_NL80211
	bool "reject non-upstreamed nl80211 commands"
	depends on CFG80211
	help
	  Say Y to disable non-upstream commands.

config IWLWIFI_DONT_DUMP_FIFOS
	bool "do not dump FIFO contents"
	help
	  If enabled, instruct the driver to not dump FIFO regions as
	  they may contain PII.
```

## drivers/net/wireless/iwlwifi/Kconfig.noupstream
```kconfig
config IWLWIFI_NUM_CHANNELS
	int "number of supported concurrent channels"
	range 1 2
	default 2
	depends on IWLMVM

config IWLMVM_POWER_SCHEME
        int "power scheme mode: 1 CAM, 2 BPS, 3 LP"
        range 1 3
        default 2
        depends on IWLMVM
	---help---
	  power scheme modes:
	  1 - Continous Active Mode (CAM):  Power save is disabled.
	  2 - Balanced Power Save (BPS): the default mode.
	      for power saving with least influence on performance.
	  3 - Low Power (LP): Best power saving mode with possible performance degradation.
	  This value might get overridden by power_scheme module_param if exists.

config IWLWIFI_DEVICE_TESTMODE
	bool "enable generic netlink testmode support"
	depends on IWLWIFI
	default y if IWLMVM
	select IWLWIFI_SUPPORT_DEBUG_OVERRIDES

config IWLWIFI_SUPPORT_DEBUG_OVERRIDES
	depends on IWLWIFI
	bool "enable default value override (for debugging)"

config IWLWIFI_PCIE_SUSPEND_RESUME
	bool "enable PCIe suspend/resume code workarounds"
	depends on IWLWIFI_PCIE
	# Intel Media requires this
	default y if CONFIG_ARCH_GEN3
	help
	  Enable this option if your base kernel has broken PCI(e)
	  suspend/resume code and the driver has to work around it
	  or if you need the driver to store and restore the PCIe
	  configuration for other reasons.

config IWLWIFI_MINI_PM_RUNTIME
	bool "internal mini-runtime PM implementation"
	depends on IWLWIFI
	default y if !PM_RUNTIME
	help
	  Enable use of an internal reference counting framework for the
	  purpose of getting the FW and bus into a low power state when
	  the WiFi component is idle.

config IWLMVM_TCM
	bool "enable traffic conditions monitoring"
	depends on IWLMVM
	default y
	help
	  This option enables (vendor) events to userspace and traffic
	  monitoring for low-latency and traffic thresholds, as well as
	  their impact on quota and other submodules.
```
